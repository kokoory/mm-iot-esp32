## esp32p4_heli_fc/main/Kconfig.projbuild
```kconfig
menu "Helicopter Flight Controller Configuration"

    menu "IMU SPI Pins"
        config IMU_SPI_SCK_PIN
            int "IMU SPI SCK GPIO"
            default 4

        config IMU_SPI_MOSI_PIN
            int "IMU SPI MOSI GPIO"
            default 5

        config IMU_SPI_MISO_PIN
            int "IMU SPI MISO GPIO"
            default 6

        config IMU_SPI_CS_PIN
            int "IMU SPI CS GPIO"
            default 7
    endmenu

    menu "I2C Pins"
        config I2C_SDA_PIN
            int "I2C SDA GPIO"
            default 8

        config I2C_SCL_PIN
            int "I2C SCL GPIO"
            default 9
    endmenu

    menu "GPS UART Pins"
        config GPS_UART_TX_PIN
            int "GPS UART TX GPIO"
            default 10

        config GPS_UART_RX_PIN
            int "GPS UART RX GPIO"
            default 11
    endmenu

    menu "PWM Pins"
        config SWASH_SERVO_1_PIN
            int "Swashplate Servo 1 GPIO"
            default 12

        config SWASH_SERVO_2_PIN
            int "Swashplate Servo 2 GPIO"
            default 13

        config SWASH_SERVO_3_PIN
            int "Swashplate Servo 3 GPIO"
            default 14

        config TAIL_ESC_PIN
            int "Tail ESC GPIO"
            default 15

        config MAIN_ESC_PIN
            int "Main ESC GPIO"
            default 16
    endmenu

    config BATT_ADC_PIN
        int "Battery ADC GPIO"
        default 17

    config STATUS_LED_PIN
        int "Status LED GPIO"
        default 18

endmenu
```

## esp32p4halow/sdkconfig.defaults.esp32p4
```kconfig
#
# ESP32-P4 HaLow Pin Configuration
#
# Available GPIOs: 2,3,4,5,7,8,20,21,22,23,24,25,26,27,28,29,30,31,32,33,
#                  46,47,48,49,50,51,52
#

# HaLow SPI pins
CONFIG_MM_RESET_N=20
CONFIG_MM_WAKE=23
CONFIG_MM_BUSY=32
CONFIG_MM_SPI_SCK=5
CONFIG_MM_SPI_MOSI=3
CONFIG_MM_SPI_MISO=2
CONFIG_MM_SPI_CS=4
CONFIG_MM_SPI_IRQ=21
CONFIG_MM_BCF_FILE="bcf_fgh100mhaamd.mbin"

CONFIG_IDF_TARGET="esp32p4"
CONFIG_FREERTOS_HZ=1000
CONFIG_ESP_DEFAULT_CPU_FREQ_MHZ_400=y
CONFIG_MBEDTLS_NIST_KW_C=y
```

## examples/esp32p4halow/sdkconfig.defaults
```kconfig
CONFIG_IDF_TARGET="esp32p4"
CONFIG_ESPTOOLPY_FLASHSIZE_16MB=y
CONFIG_PARTITION_TABLE_CUSTOM=y
CONFIG_SPIRAM=y
CONFIG_SPIRAM_MODE_OCT=y
CONFIG_SPIRAM_SPEED_200M=y
CONFIG_FREERTOS_HZ=1000
CONFIG_FREERTOS_TIMER_TASK_PRIORITY=10
CONFIG_LWIP_IRAM_OPTIMIZATION=y
CONFIG_LWIP_IPV6_AUTOCONFIG=y
CONFIG_LWIP_IPV6_DHCP6=y
CONFIG_LWIP_NETIF_STATUS_CALLBACK=y
CONFIG_LWIP_NETIF_LINK_CALLBACK=y
CONFIG_LWIP_TCP_MSS=1460
CONFIG_LWIP_TCP_SND_BUF_DEFAULT=8760
CONFIG_LWIP_TCP_WND_DEFAULT=14600
CONFIG_LWIP_TCP_RECVMBOX_SIZE=10
CONFIG_LWIP_UDP_RECVMBOX_SIZE=10
CONFIG_MBEDTLS_NIST_KW_C=y
CONFIG_ESP_TIMER_PROFILING=y
```

## framework/mm_shims/Kconfig
```kconfig
# Copyright 2024 Morse Micro
# SPDX-License-Identifier: Apache-2.0
menu "Morse Micro Shim Configuration"
    config MM_RESET_N
        int "RESET_N pin for MM chip"
        default 1
        help
            Output gpio pin used to control the RESET_N line.
            Default is GPIO 1 (XIAO D0) for Seeed Studio XIAO ESP32S3 + WM6180 HaLow.

    config MM_WAKE
        int "WAKE pin for MM chip"
        default 2
        help
            Output gpio pin used to control the WAKE line.
            Default is GPIO 2 (XIAO D1) for Seeed Studio XIAO ESP32S3 + WM6180 HaLow.

    config MM_BUSY
        int "BUSY pin for the MM chip"
        default 5
        help
            Input pin used as a rising edge interrupt.
            Default is GPIO 5 (XIAO D4) for Seeed Studio XIAO ESP32S3 + WM6180 HaLow.
            Note: BUSY pin is not wired on Seeed XIAO HaLow boards.
            Power save must be disabled as a workaround.

    config MM_SPI_SCK
        int "SCK pin for MM chip"
        default 7
        help
            SPI clock pin.
            Default is GPIO 7 (XIAO D8/SCK) for Seeed Studio XIAO ESP32S3 + WM6180 HaLow.

    config MM_SPI_MOSI
        int "MOSI pin for MM chip"
        default 9
        help
            SPI master out slave in pin.
            Default is GPIO 9 (XIAO D10/MOSI) for Seeed Studio XIAO ESP32S3 + WM6180 HaLow.

    config MM_SPI_MISO
        int "MISO pin for MM chip"
        default 8
        help
            SPI master in slave out pin.
            Default is GPIO 8 (XIAO D9/MISO) for Seeed Studio XIAO ESP32S3 + WM6180 HaLow.

    config MM_SPI_CS
        int "SPI CS pin for MM chip"
        default 4
        help
            SPI chip select pin.
            Default is GPIO 4 (XIAO D3) for Seeed Studio XIAO ESP32S3 + WM6180 HaLow.

    config MM_SPI_IRQ
        int "SPI IRQ pin for MM chip"
        default 3
        help
            Out of band interupt pin used to indicate that
            the MM chip has data for the host.
            Default is GPIO 3 (XIAO D2) for Seeed Studio XIAO ESP32S3 + WM6180 HaLow.

    config MM_BCF_FILE
        string "MM Board Configuration File"
        default "bcf_mf08651_us.mbin"
        help
            Set the name of the BCF (Board Configuration File) to use.

            This file provides board-specific configuration data for the Morse Micro chip/module.

            The build system will search for the specified file in the following locations:
              1. morsefirmware/ in the root of the application being built
              2. framework/morsefirmware/ in the mm-iot-esp32 SDK (defined via the MMIOT_ROOT environment variable)

            If the file is not found in either location, a warning will be reported during
            configuration.

    config MM_FW_FILE
        string "MM Firmware File"
        default "mm6108.mbin"
        help
            This is the firmware file for the Morse Micro chip/module.

            The build system will search for the specified file in the following locations:
              1. morsefirmware/ in the root of the application being built
              2. framework/morsefirmware/ in the mm-iot-esp32 SDK (defined via the MMIOT_ROOT environment variable)

            If the file is not found in either location, a warning will be reported during
            configuration.

    choice MMHAL_CHIP_TYPE
        bool "MM Chip Ops"
        default MMHAL_CHIP_TYPE_MM6108
        help
            This specifies which chip function ops should be used by morselib.

        config MMHAL_CHIP_TYPE_MM6108
            bool "mmhal_mm6108"
        config MMHAL_CHIP_TYPE_MM8108
            bool "mmhal_mm8108"
    endchoice
endmenu
```
